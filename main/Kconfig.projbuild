## main/Kconfig.projbuild
```kconfig
menu "HomeBuzzer App Configuration"

    config BUZZER_PEER_ADDR
        string "Peer Address"
        default "ADDR_ANY"
        help
            Enter the peer address in aa:bb:cc:dd:ee:ff form to connect to a specific peripheral

    config BUZZER_MMC_MOSI
        int "MOSI GPIO number"
        default 15 if IDF_TARGET_ESP32
        default 35 if IDF_TARGET_ESP32S2
        default 35 if IDF_TARGET_ESP32S3
        default 23  # M5-Stack
        # default 4  # C3 and others

    config BUZZER_MMC_MISO
        int "MISO GPIO number"
        default 2 if IDF_TARGET_ESP32
        default 37 if IDF_TARGET_ESP32S2
        default 37 if IDF_TARGET_ESP32S3
        default 19  # M5-Stack
        # default 6  # C3 and others

    config BUZZER_MMC_CLK
        int "CLK GPIO number"
        default 14 if IDF_TARGET_ESP32
        default 36 if IDF_TARGET_ESP32S2
        default 36 if IDF_TARGET_ESP32S3
        default 18  # M5-Stack
        # default 5  # C3 and others

    config BUZZER_MMC_CS
        int "CS GPIO number"
        default 13 if IDF_TARGET_ESP32
        default 34 if IDF_TARGET_ESP32S2
        default 34 if IDF_TARGET_ESP32S3
        default 4   # M5-Stack
        # default 1  # C3 and others

endmenu
```
